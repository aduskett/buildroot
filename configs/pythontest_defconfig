## configs/pythontest_defconfig
```kconfig
BR2_x86_64=y
BR2_x86_corei7_avx=y
BR2_TOOLCHAIN_EXTERNAL=y
BR2_TOOLCHAIN_EXTERNAL_DOWNLOAD=y
BR2_TOOLCHAIN_EXTERNAL_URL="https://toolchains.bootlin.com/downloads/releases/toolchains/x86-64-core-i7/tarballs/x86-64-core-i7--glibc--bleeding-edge-2018.07-3.tar.bz2"
BR2_TOOLCHAIN_EXTERNAL_GCC_8=y
BR2_TOOLCHAIN_EXTERNAL_HEADERS_4_14=y
BR2_TOOLCHAIN_EXTERNAL_CUSTOM_GLIBC=y
BR2_TOOLCHAIN_EXTERNAL_CXX=y
BR2_PACKAGE_PYTHON3=y
BR2_PACKAGE_PYTHON_CRYPTOGRAPHY=y
```

## package/lmdb/Config.in
```kconfig
config BR2_PACKAGE_LMDB
	bool "lmdb"
	depends on BR2_TOOLCHAIN_HAS_THREADS # pthreads
	depends on BR2_USE_WCHAR
	help
	  LMDB is an ultra-fast, ultra-compact key-value embedded data
	  store developed by Symas for the OpenLDAP Project. By using
	  memory-mapped files, it provides the read performance of a
	  pure in-memory database while still offering the persistence
	  of standard disk-based databases, and is only limited to the
	  size of the virtual address space.

	  https://github.com/LMDB/lmdb/tree/mdb.master/libraries/liblmdb

comment "lmdb needs a toolchain w/ threads, wchar"
	depends on !BR2_TOOLCHAIN_HAS_THREADS || !BR2_USE_WCHAR
```

## package/lmdbxx/Config.in
```kconfig
config BR2_PACKAGE_LMDBXX
	bool "lmdbxx"
	depends on BR2_TOOLCHAIN_GCC_AT_LEAST_7 # C++17
	depends on BR2_TOOLCHAIN_HAS_THREADS # lmdb
	depends on BR2_USE_WCHAR # lmdb
	select BR2_PACKAGE_LMDB
	help
	  lmdb++: a C++17 wrapper for LMDB
	  This is a comprehensive C++ wrapper for the LMDB embedded
	  database library, offering both an error-checked procedural
	  interface and an object-oriented resource interface with RAII
	  semantics.

	  https://github.com/hoytech/lmdbxx/

comment "lmdbxx needs a toolchain w/ wchar, threads, gcc >= 7"
	depends on BR2_USE_MMU
	depends on !BR2_TOOLCHAIN_GCC_AT_LEAST_7 || !BR2_USE_WCHAR || \
		!BR2_TOOLCHAIN_HAS_THREADS
```

## package/optional-lite/Config.in
```kconfig
config BR2_PACKAGE_OPTIONAL_LITE
	bool "optional-lite"
	depends on BR2_INSTALL_LIBSTDCPP
	help
	  optional lite is a single-file header-only library to
	  represent optional (nullable) objects and pass them by value.
	  The library aims to provide a C++17-like optional for use with
	  C++98 and later. If available, std::optional is used.

	  https://github.com/martinmoene/optional-lite

comment "optional-lite needs a toolchain w/ C++"
	depends on !BR2_INSTALL_LIBSTDCPP
```
